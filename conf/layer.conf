## conf/layer.conf
```bitbake
# We have a conf and classes directory, append to BBPATH
BBPATH .= ":${LAYERDIR}"

# We have a recipes directory, add to BBFILES
BBFILES += "${LAYERDIR}/recipes*/*/*.bb ${LAYERDIR}/recipes*/*/*.bbappend"

BBFILE_COLLECTIONS += "meta-linux-telephony"
BBFILE_PATTERN_meta-linux-telephony := "^${LAYERDIR}/"
BBFILE_PRIORITY_meta-linux-telephony = "6"

LICENSE_PATH += "${LAYERDIR}/licenses"

# Layer's in heavy development.  Tracks latest stable/LTS (Maybe both...)
# at the least...
LAYERVERSION_meta-linux-telephony = "1"
LAYERDEPENDS_meta-linux-telephony = "core"
LAYERSERIES_COMPAT_meta-linux-telephony = "scarthgap"

# Recipe modifications for other layers that may be included in the build as
# we supply mods for more than just the core here.  meta-efl, etc. joins in
# on the fun so we have this handled in one tidy package instead of several
# spread out layersets.
BBFILES += "${@' '.join('${LAYERDIR}/external/%s/recipes*/*/*.bb' % layer \
               for layer in BBFILE_COLLECTIONS.split() if os.path.exists(os.path.join('${LAYERDIR}','external',layer)))}"
BBFILES += "${@' '.join('${LAYERDIR}/external/%s/recipes*/*/*.bbappend' % layer \
               for layer in BBFILE_COLLECTIONS.split() if os.path.exists(os.path.join('${LAYERDIR}','external',layer)))}"
```
